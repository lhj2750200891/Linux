## mcu/gd32_f1_sdk/Documentation/devicetree/bindings/input/gd,gpio-keys.yaml
```yaml
# SPDX-License-Identifier: GPL-2.0-only OR BSD-2-Clause
%YAML 1.2
---
$id: http://devicetree.org/schemas/input/gd,gpio-keys.yaml#
$schema: http://devicetree.org/meta-schemas/core.yaml#

title: GD32F10x GPIO independent keys

maintainers:
  - lhj <houjun.li>

description: |
  独立按键容器节点, 驱动 drivers/key/ 消费 (key_scan / key_read / key_callback)。
  子节点 = 按键实例; key_scan() 返回键值 = 子节点下标 + 1。

  两种工作方式由 key-mode 选择:
    KEY_MODE_IRQ  (默认) EXTI 外部中断, 免主循环轮询;
                  每键触发类型 trigger 可配 (上升/下降/双沿)
    KEY_MODE_POLL        纯轮询, 应用周期调 key_scan(), 消抖时间 debounce-ms
  (常量定义: arm/include/dt-bindings/input/gd32f10x-key.h)

properties:
  compatible:
    const: gd,gpio-keys

  count:
    $ref: /schemas/types.yaml#/definitions/uint32
    description: 实例个数, 必须与子节点数一致 (脚本校验)。

  key-mode:
    enum: [0, 1]
    default: 0
    description: |
      0 = KEY_MODE_IRQ   EXTI 中断 (默认)
      1 = KEY_MODE_POLL  轮询

  debounce-ms:
    $ref: /schemas/types.yaml#/definitions/uint32
    default: 20
    description: 轮询模式消抖时间 (ms), 仅 key-mode=<KEY_MODE_POLL> 生效。

  status:
    enum: [okay, disabled]

patternProperties:
  "^key[0-9a-z_-]+$":
    type: object
    properties:
      gpios:
        maxItems: 1
        description: 单元格式 <&gpio端口 引脚号 模式>, 模式取
          dt-bindings/gpio/gd32f10x-gpio.h (输入用 GD32_MODE_IPU/IPD/IN_FLOATING)。

      active-level:
        enum: [0, 1]
        description: |
          按下时的有效电平; "按下" = 读到电平与该值一致。
          缺省按引脚上下拉推导 (显式配置优先):
            GD32_MODE_IPU (上拉) -> 按下接地 -> 低有效(0)
            GD32_MODE_IPD (下拉) -> 按下接高 -> 高有效(1)
            浮空/模拟输入 -> 默认低有效(0)

      trigger:
        enum: [0, 1, 2]
        description: |
          EXTI 中断触发类型, 仅 key-mode=<KEY_MODE_IRQ> 生效
          (轮询模式不用 trigger, 高/低有效按键均可):
            0 = KEY_TRIG_RISING   上升沿
            1 = KEY_TRIG_FALLING  下降沿
            2 = KEY_TRIG_BOTH     双沿 (按下与松开都触发)
          缺省按有效电平推导: 低有效 -> 下降沿(1), 高有效 -> 上升沿(0)。
          注意: EXTI 线号 = 引脚号, 同一引脚号 (不同端口) 的两个按键
          不能同时用中断模式 (AFIO 信号源只有一个)。

    required:
      - gpios
    additionalProperties: false

required:
  - compatible
  - count

additionalProperties: false

examples:
  - |
    keys {
        compatible = "gd,gpio-keys";
        status = "okay";
        count = <2>;
        key-mode = <KEY_MODE_IRQ>;    /* EXTI 中断 (默认, 可省略) */

        /* 上拉输入, 按下接地: 低电平有效, 下降沿触发 */
        key1 { gpios = <&gpioa 7 GD32_MODE_IPU>;
               active-level = <GD32_LEVEL_LOW>;
               trigger = <KEY_TRIG_FALLING>; };

        /* 下拉输入, 按下接高: 高电平有效, 上升沿触发 */
        key2 { gpios = <&gpioa 0 GD32_MODE_IPD>;
               active-level = <GD32_LEVEL_HIGH>;
               trigger = <KEY_TRIG_RISING>; };
    };

  - |
    keys {
        compatible = "gd,gpio-keys";
        status = "okay";
        count = <2>;
        key-mode = <KEY_MODE_POLL>;    /* 轮询: 主循环周期调 key_scan() */
        debounce-ms = <30>;            /* 消抖 30ms */

        key1 { gpios = <&gpioa 7 GD32_MODE_IPU>; active-level = <GD32_LEVEL_LOW>; };
        key2 { gpios = <&gpioa 0 GD32_MODE_IPD>; active-level = <GD32_LEVEL_HIGH>; };
    };
...
```

## mcu/gd32_f1_sdk/Documentation/devicetree/bindings/input/gd,gpio-matrix-keys.yaml
```yaml
# SPDX-License-Identifier: GPL-2.0-only OR BSD-2-Clause
%YAML 1.2
---
$id: http://devicetree.org/schemas/input/gd,gpio-matrix-keys.yaml#
$schema: http://devicetree.org/meta-schemas/core.yaml#

title: GD32F10x GPIO matrix keypad

maintainers:
  - lhj <houjun.li>

description: |
  矩阵键盘容器节点, 驱动 drivers/matrix_key/ 消费 (matrix_key_scan)。
  行(row)配推挽输出逐行扫描, 列(col)配上拉输入读键;
  返回键值 = 行号 * col-count + 列号 + 1。

properties:
  compatible:
    const: gd,gpio-matrix-keys

  row-count:
    $ref: /schemas/types.yaml#/definitions/uint32
    description: 行数, 必须与 row-gpios 组数一致。

  col-count:
    $ref: /schemas/types.yaml#/definitions/uint32
    description: 列数, 必须与 col-gpios 组数一致。

  row-gpios:
    minItems: 1
    description: 行引脚列表, 每组 <&gpio端口 引脚 模式>, 推荐全用
      GD32_MODE_OUT_PP; 扫描时逐行拉低。

  col-gpios:
    minItems: 1
    description: 列引脚列表, 推荐全用 GD32_MODE_IPU。

  status:
    enum: [okay, disabled]

required:
  - compatible
  - row-count
  - col-count
  - row-gpios
  - col-gpios

additionalProperties: false

examples:
  - |
    matrix-keys {
        compatible = "gd,gpio-matrix-keys";
        status = "okay";
        row-count = <4>;
        col-count = <3>;

        row-gpios = <&gpioc 0 GD32_MODE_OUT_PP>,
                    <&gpioc 1 GD32_MODE_OUT_PP>,
                    <&gpioc 2 GD32_MODE_OUT_PP>,
                    <&gpioc 3 GD32_MODE_OUT_PP>;
        col-gpios = <&gpioa 4 GD32_MODE_IPU>,
                    <&gpioa 5 GD32_MODE_IPU>,
                    <&gpioa 6 GD32_MODE_IPU>;
    };
...
```

## mcu/gd32_f1_sdk/Documentation/devicetree/bindings/leds/gd,gpio-leds.yaml
```yaml
# SPDX-License-Identifier: GPL-2.0-only OR BSD-2-Clause
%YAML 1.2
---
$id: http://devicetree.org/schemas/leds/gd,gpio-leds.yaml#
$schema: http://devicetree.org/meta-schemas/core.yaml#

title: GD32F10x GPIO LED

maintainers:
  - lhj <houjun.li>

description: |
  LED 容器节点, 驱动 drivers/led/ 消费 (led_set / led_toggle)。
  子节点 = LED 实例, 个数与顺序由 count/子节点声明决定;
  按名字访问用生成宏 DT_<名>_IDX, 例 led_set(DT_LED1_IDX, 1)。

properties:
  compatible:
    const: gd,gpio-leds

  count:
    $ref: /schemas/types.yaml#/definitions/uint32
    description: 实例个数, 必须与子节点数一致 (脚本校验)。

  status:
    enum: [okay, disabled]
    description: disabled 时只生成 COUNT 0, 驱动不初始化 (API 为空实现)。

patternProperties:
  "^led[0-9a-z_-]+$":
    type: object
    properties:
      gpios:
        maxItems: 1
        description: 单元格式 <&gpio端口 引脚号 模式>, 模式取
          dt-bindings/gpio/gd32f10x-gpio.h (输出用 GD32_MODE_OUT_PP/OUT_OD)。

      init-level:
        enum: [0, 1]
        default: 0
        description: 上电初始电平 (GD32_LEVEL_LOW/HIGH)。

    required:
      - gpios
    additionalProperties: false

required:
  - compatible
  - count

additionalProperties: false

examples:
  - |
    leds {
        compatible = "gd,gpio-leds";
        status = "okay";
        count = <2>;

        led1 { gpios = <&gpioc 13 GD32_MODE_OUT_PP>; init-level = <GD32_LEVEL_HIGH>; };
        led2 { gpios = <&gpioc 9  GD32_MODE_OUT_PP>; init-level = <GD32_LEVEL_HIGH>; };
    };
...
```

## mcu/gd32_f1_sdk/Documentation/devicetree/bindings/serial/gd,gd32-uart.yaml
```yaml
# SPDX-License-Identifier: GPL-2.0-only OR BSD-2-Clause
%YAML 1.2
---
$id: http://devicetree.org/schemas/serial/gd,gd32-uart.yaml#
$schema: http://devicetree.org/meta-schemas/core.yaml#

title: GigaDevice GD32F10x UART/USART

maintainers:
  - lhj <houjun.li>

description: |
  裸机 SDK 的串口驱动绑定, 由 scripts/gen_devicetree.py 解析并在编译期
  生成 C 实例表 (DT_UARTS_INSTANCES), 驱动 drivers/uart/ 消费。

  节点分三层:
    SoC dtsi:   gd,gd32-uart-periph     外设节点 (基址/序号)
                gd,gd32-uart-pingroup   引脚分组 (TX/RX 组合表)
    板级 dts:   gd,gd32-uart           uarts 容器, 子节点 = 实例

  引脚两种描述方式二选一:
    pgroup                    引用预定义组 (组号 0=默认, 1=重映射)
    tx-gpios + rx-gpios       手动组合 (数据手册 2.6 节中任何标了
                              USARTx_TX/RX 复用功能的引脚, 需写 uart-idx;
                              若引脚属于重映射组还需 remap = <1>)

  驱动模式 (每个实例独立):
    dma-mode = 0, int-mode = 0              纯轮询
    dma-mode = 0, int-mode = 1 (RX)         RBNE 每字节中断
    dma-mode = 0, int-mode = 2 (IDLE)       仅空闲中断
    dma-mode = 0, int-mode = 3 (RX|IDLE)    纯中断不定长接收
    dma-mode = 1, int-mode = 2 (推荐)       DMA 收 + IDLE 判帧, TX 走 DMA
                                            (UART4 无 DMA 通道, 自动退化为中断)

properties:
  compatible:
    enum:
      - gd,gd32-uart           # 板级实例容器
      - gd,gd32-uart-periph    # SoC 外设节点
      - gd,gd32-uart-pingroup  # SoC 引脚分组节点

  reg:
    maxItems: 1
    description: 外设基址 (USART0=0x40013800 APB2, 其余 APB1)

  count:
    $ref: /schemas/types.yaml#/definitions/uint32
    description: |
      容器内实例个数。可选: 缺省按启用 (status != "disabled") 的子节点数
      自动计数; 显式写出时脚本校验须与启用子节点数一致。

  status:
    enum: [ okay, disabled ]
    description: |
      两级开关: 容器级 disabled 整类串口不生成实例表; 子节点 (uart1/uart2/...)
      级 disabled 只裁掉该实例 —— 其余实例下标自动重排, 该实例的
      DT_UARTx_IDX 宏仍生成 (值为哨兵 0xFF), 驱动 API 收到后安全空操作,
      应用代码无需修改。

  uart-idx:
    $ref: /schemas/types.yaml#/definitions/uint32
    enum: [0, 1, 2, 3, 4]
    description: |
      0=USART0, 1=USART1, 2=USART2 (均有 DMA); 3=UART3 (DMA1);
      4=UART4 (无 DMA)。periph/pingroup 节点必写; 手动组合引脚的实例必写。

  groups:
    $ref: /schemas/types.yaml#/definitions/uint32-array
    description: |
      引脚组表, 每组 6 单元: <组号 &tx端口 tx引脚 &rx端口 rx引脚 重映射>。
      组号 0 是默认组(m0); 重映射 1 表示该组需要 AFIO 重映射。

  '#pin-group-cells':
    const: 1

  pgroup:
    $ref: /schemas/types.yaml#/definitions/phandle-array
    description: 引用 periph 节点 + 组号, 形如 <&usart0 0>。

  tx-gpios:
    maxItems: 1
    description: 手动组合 TX 引脚 (模式单元忽略, 驱动自配 AF_PP)。

  rx-gpios:
    maxItems: 1
    description: 手动组合 RX 引脚 (模式单元忽略, 驱动按 rx-pull 配置)。

  remap:
    type: boolean
    description: 手动组合引脚属于重映射组时置 1 (如 USART2 用 PC10/PC11)。

  baud-rate:
    $ref: /schemas/types.yaml#/definitions/uint32
    default: 115200

  data-bits:
    enum: [0, 1]        # 0 = 8 位, 1 = 9 位
    default: 0

  stop-bits:
    enum: [0, 1, 2]     # 0 = 1 位, 1 = 0.5 位, 2 = 2 位
    default: 0

  parity:
    enum: [0, 2, 3]     # 0 = 无, 2 = 偶, 3 = 奇
    default: 0

  dma-mode:
    type: boolean
    description: 置 1 启用 DMA 收发。

  int-mode:
    enum: [0, 1, 2, 3]  # GD32_UART_INT_{NONE,RX,IDLE,RX_IDLE} (dt-bindings)
    default: 0

  rx-pull:
    type: boolean
    description: 置 1 RX 上拉输入, 否则浮空。

  rx-buf-size:
    $ref: /schemas/types.yaml#/definitions/uint32
    default: 128
    description: RX 环形缓冲区字节数 (须为 2 的幂效果最佳, DMA 循环回卷)。

  console:
    type: boolean
    description: 置 1 时 printf 重定向到本实例 (整棵树至多一个)。

required:
  - compatible

additionalProperties: false

examples:
  # SoC dtsi 片段
  - |
    uart0grp: pin-group@0 {
        compatible = "gd,gd32-uart-pingroup";
        uart-idx = <0>;
        groups = <
            /* m0: PA9=TX, PA10=RX (默认) */
            0 &gpioa 9  &gpioa 10 0
            /* m1: PB6=TX, PB7=RX (重映射) */
            1 &gpiob 6  &gpiob 7  1>;
    };

  # 板级 dts: DMA + IDLE + printf console
  - |
    uarts {
        compatible = "gd,gd32-uart";

        uart1 {
            status = "okay";
            pgroup = <&usart0 0>;
            baud-rate = <115200>;
            dma-mode = <1>;
            int-mode = <2>;       /* GD32_UART_INT_IDLE */
            rx-buf-size = <128>;
            console = <1>;
        };

        /* 手动组合引脚: USART2 部分重映射组 PC10/PC11, 纯中断接收 */
        uart2 {
            tx-gpios = <&gpioc 10 GD32_MODE_AF_PP>;
            rx-gpios = <&gpioc 11 GD32_MODE_IN_FLOATING>;
            uart-idx = <2>;
            remap = <1>;
            baud-rate = <9600>;
            int-mode = <3>;       /* GD32_UART_INT_RX_IDLE */
        };
    };
...
```

## mcu/gd32_f1_sdk/Documentation/devicetree/bindings/timer/gd,cortex-m-systick.yaml
```yaml
# SPDX-License-Identifier: GPL-2.0-only OR BSD-2-Clause
%YAML 1.2
---
$id: http://devicetree.org/schemas/timer/gd,cortex-m-systick.yaml#
$schema: http://devicetree.org/meta-schemas/core.yaml#

title: ARM Cortex-M3 SysTick (delay timer)

maintainers:
  - lhj <houjun.li>

description: |
  内核 SysTick 延时驱动 (drivers/systick/, sys_delay_us / sys_delay_ms)。
  位于 SoC dtsi; clock-frequency 是延时基准, 需与 vendor 库实际主频配置
  一致 (默认 __SYSTEM_CLOCK_108M_PLL); 板卡换主频时在板级 dts 覆写。

properties:
  compatible:
    const: gd,cortex-m-systick

  reg:
    maxItems: 1
    description: SysTick 基址 0xe000e010, 长度 0x10。

  clock-frequency:
    $ref: /schemas/types.yaml#/definitions/uint32
    description: CPU 时钟 Hz。注意本工程该值必须与 system_gd32f10x.c
      的主频配置一致, 否则延时计时不准。

required:
  - compatible
  - reg
  - clock-frequency

additionalProperties: false

examples:
  - |
    systick: systick@e000e010 {
        compatible = "gd,cortex-m-systick";
        reg = <0xe000e010 0x10>;
        clock-frequency = <108000000>;
    };
...
```

## mcu/gd32_f1_sdk/Kconfig
```kconfig
mainmenu "GD32F10x 固件框架"

menu "板卡 / 芯片"
# 一个工程可对应多块板卡, 由 defconfig 决定用哪块板的硬件描述

# 芯片标记(多块板卡共用同一颗芯片)
config CHIP_GD32F103RE
	bool
	default y

# 板卡设备树: 由各板卡的 defconfig 指定 (构建时的硬件描述来源)
config BOARD_DTS
	string "板卡设备树文件(相对工程根目录的路径)"
	default ""

endmenu

source "drivers/Kconfig"
```

## mcu/gd32_f1_sdk/application/gd32f103re/uart_echo/defconfig
```kconfig
# uart_echo 应用配置 (覆盖板级 configs/gd32f103re_defconfig)
# 本应用只需要串口 + systick, 裁掉 LED/按键/矩阵键盘
CONFIG_CHIP_GD32F103RE=y
CONFIG_BOARD_DTS=arm/boards/gd32f103re/gd32f103re.dts
CONFIG_DRIVER_SYSTICK=y
CONFIG_DRIVER_GPIO_GD32=y
CONFIG_DRIVER_UART=y
CONFIG_DRIVER_UART_PRINTF=y
# CONFIG_DRIVER_LED is not set
# CONFIG_DRIVER_KEY is not set
# CONFIG_DRIVER_MATRIX_KEY is not set
```

## mcu/gd32_f1_sdk/configs/gd32f103re_demo_defconfig
```kconfig
# gd32f103re_demo 演示板配置
# 同一颗芯片、不同的板卡: 指定自己的设备树, 硬件裁剪也不同(无矩阵键盘, 消抖 30ms)
# 板卡之间的差异 = defconfig + 它指定的设备树, 驱动代码完全共用
CONFIG_CHIP_GD32F103RE=y
CONFIG_BOARD_DTS=boards/gd32f103re_demo/gd32f103re_demo.dts
CONFIG_DRIVER_SYSTICK=y
CONFIG_DRIVER_GPIO_GD32=y
CONFIG_DRIVER_LED=y
CONFIG_DRIVER_KEY=y
CONFIG_KEY_DEBOUNCE_MS=30
# CONFIG_DRIVER_MATRIX_KEY is not set
CONFIG_DRIVER_UART=y
# CONFIG_DRIVER_UART_PRINTF is not set
```
