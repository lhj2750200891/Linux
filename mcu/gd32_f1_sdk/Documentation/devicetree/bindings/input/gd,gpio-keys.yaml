## mcu/gd32_f1_sdk/drivers/Kconfig
```kconfig
menu "驱动配置"
# 这里的 CONFIG_xxx 有两个作用:
#   1) C 代码层面: 生成 autoconf.h, 驱动/应用用 #ifdef CONFIG_xxx 条件编译
#   2) Make 层面: Makefile include .config, 通过 obj-$(CONFIG_xxx) 决定哪些驱动参与编译

config DRIVER_SYSTICK
	bool "SysTick 延时驱动 (设备树 systick 节点)"
	default y
	help
		  基于 Cortex-M3 内核 SysTick 的阻塞延时 (systick_init / sys_delay_us /
		  sys_delay_ms), CPU 时钟频率来自设备树 systick 节点的 clock-frequency。
		  key / matrix_key 的消抖扫描依赖本驱动提供的延时。

config DRIVER_GPIO_GD32
	bool "GD32 GPIO 核心驱动 (设备树驱动)"
	default y
	help
		  GD32F10x GPIO 的配置/读写/翻转驱动, 引脚信息全部来自设备树
		  (build/generated/devicetree_generated.h)。
		  是 led / key / matrix_key 驱动的基础, 关闭后它们也无法工作。

config DRIVER_LED
	bool "LED 驱动 (设备树 leds 节点)"
	default y
	depends on DRIVER_GPIO_GD32
	help
		  扫描设备树中 compatible = "gd,gpio-leds" 的节点, 生成 LED 实例表,
		  提供 led_set / led_toggle / LED1(x) 等接口。

config DRIVER_KEY
	bool "独立按键驱动 (设备树 keys 节点)"
	default y
	depends on DRIVER_GPIO_GD32
	depends on DRIVER_SYSTICK
	help
		  扫描设备树中 compatible = "gd,gpio-keys" 的节点, 提供按键消抖
		  扫描 key_scan() 与 KEY1~KEY4 读电平宏。

config DRIVER_MATRIX_KEY
	bool "矩阵键盘驱动 (设备树 matrix-keys 节点)"
	default y
	depends on DRIVER_GPIO_GD32
	depends on DRIVER_SYSTICK
	help
		  扫描设备树中 compatible = "gd,gpio-matrix-keys" 节点的
		  row-gpios / col-gpios, 提供逐行扫描 matrix_key_scan()。

config MATRIX_ROW_DELAY_MS
	int "矩阵扫描行切换延时 (ms)"
	default 10
	depends on DRIVER_MATRIX_KEY
	help
		  矩阵扫描拉低每一行后, 等待电平稳定的时间。
config DRIVER_UART
	bool "UART/USART 串口驱动 (设备树 uarts 节点)"
	default y
	depends on DRIVER_GPIO_GD32
	help
		  扫描设备树中 compatible = "gd,gd32-uart" 的 uarts 节点, 生成串口实例表。
		  每个实例支持三种工作模式(设备树 dma-mode/int-mode 属性):
		  纯轮询 / 中断(RBNE+IDLE) / DMA 收发(空闲中断判帧), printf 可重定向到
		  console=1 的实例。引脚可用 dtsi 预定义组(pgroup)或手动组合
		  (数据手册 2.6 节中标了 USARTx_TX/RX 的任意引脚)。

config DRIVER_UART_PRINTF
	bool "printf 重定向到 console 串口"
	default y
	depends on DRIVER_UART
	help
		  重定向 newlib 的 _write() 到设备树中 console=1 的 uart 实例,
		  应用层直接使用 printf 即可输出。

config DRIVER_TIMER
	bool "GD32 定时器驱动 (基本 TIMER5/6 + 通用 TIMER1~4, 设备树 basic-timers/general-timers 节点)"
	default y
	help
		  扫描设备树中 compatible = "gd,gd32-basic-timer" / "gd,gd32-general-timer"
		  的节点, 生成实例表:
		  - 基本定时器 TIMER5/6: 周期溢出中断/纯计数 (basic_timer_* API)
		  - 通用定时器 TIMER1~4: PWM 输出/输入捕获测频/双通道测频测占空比/
		    纯定时中断 (general_timer_* API, 模式四选一)
		  basic_timer_callback(idx)。通用/高级定时器后续各自独立实现。

config DRIVER_I2C
	bool "GD32 I2C 主机驱动 (设备树 i2c-buses 节点)"
	default y
	depends on DRIVER_GPIO_GD32
	help
		  扫描设备树中 compatible = "gd,gd32-i2c" 的 i2c-buses 节点, 每个
		  子节点一条 I2C 总线 (一主), 总线的子节点 = 挂载的从机设备
		  (一主多从, 每个从机节点独立 status 开关, reg = 7 位地址)。
		  提供 i2c_probe / i2c_write / i2c_read / i2c_write_then_read /
		  i2c_write_reg / i2c_read_reg, 从机句柄 = 设备树生成的 DT_<名>_IDX。
		  阻塞式轮询传输, 带 NACK/超时检测和 SCL 九脉冲总线恢复。
		  设备树无该节点时编译为空实现, 不影响其他功能。

config DRIVER_SPI
	bool "GD32 SPI 主机驱动 (设备树 spi-buses 节点)"
	default y
	depends on DRIVER_GPIO_GD32
	help
		  扫描设备树中 compatible = "gd,gd32-spi" 的 spi-buses 节点, 每个
		  子节点一条 SPI 总线 (一主), cs-gpios 列出软片选 GPIO, 总线的
		  子节点 = 挂载的从机设备 (reg = cs-gpios 下标, 一主多从)。
		  提供 spi_transfer / spi_write / spi_read / spi_write_then_read /
		  spi_cs_set, 从机句柄 = 设备树生成的 DT_<名>_IDX。
		  使用 PA15/PB3/PB4 引脚时自动禁 JTAG 保留 SWD。
		  设备树无该节点时编译为空实现, 不影响其他功能。

config DRIVER_OLED
	bool "SSD1306 OLED 驱动 (I2C 从机设备)"
	default y
	depends on DRIVER_I2C
	depends on DRIVER_SYSTICK
	help
		  SSD1306 128x64 OLED 显示驱动 (8x16 字库), 走 DRIVER_I2C 的
		  从机句柄。应用显式调用 oled_init(DT_OLED0_IDX) 初始化,
		  提供 oled_show_string / oled_show_num 等显示接口。
		  OLED 未接或从机节点未挂载时初始化返回错误码, 不挂死系统。

endmenu
```
